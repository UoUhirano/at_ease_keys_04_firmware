#include <dt-bindings/zmk/matrix_transform.h>

/ {
    chosen {
        zmk,kscan = &kscan0;
        zmk,split = &split;
    };

    kscan0: kscan_0 {
        compatible = "zmk,kscan-matrix";
        label = "KSCAN";
        diode-direction = "col2row";

        // TODO: ↓↓↓ あなたのキーボードの配線に合わせてピン番号を修正してください ↓↓↓
        col-gpios
            = <&xiao_d 0 (GPIO_ACTIVE_HIGH)>
            , <&xiao_d 1 (GPIO_ACTIVE_HIGH)>
            , <&xiao_d 2 (GPIO_ACTIVE_HIGH)>
            , <&xiao_d 3 (GPIO_ACTIVE_HIGH)>
            , <&xiao_d 4 (GPIO_ACTIVE_HIGH)>
            , <&xiao_d 5 (GPIO_ACTIVE_HIGH)>
            , <&xiao_d 6 (GPIO_ACTIVE_HIGH)>
            , <&xiao_d 7 (GPIO_ACTIVE_HIGH)>
            ;

        row-gpios
            = <&xiao_d 8 (GPIO_ACTIVE_HIGH | GPIO_PULL_DOWN)>
            , <&xiao_d 9 (GPIO_ACTIVE_HIGH | GPIO_PULL_DOWN)>
            , <&xiao_d 10 (GPIO_ACTIVE_HIGH | GPIO_PULL_DOWN)>
            , <&xiao_d 11 (GPIO_ACTIVE_HIGH | GPIO_PULL_DOWN)>
            ;
    };

    split: split {
        compatible = "zmk,split-bt";
        label = "SPLIT";
    };
};