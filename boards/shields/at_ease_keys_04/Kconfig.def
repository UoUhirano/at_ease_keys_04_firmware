## boards/shields/at_ease_keys_04/Kconfig.shield
```kconfig
config SHIELD_AT_EASE_KEYS_04_LEFT
    def_bool $(shields_list_contains,at_ease_keys_04_left)

config SHIELD_AT_EASE_KEYS_04_RIGHT
    def_bool $(shields_list_contains,at_ease_keys_04_right)
```
