/*
 * config/boards/shields/at_ease_keys_04/at_ease_keys_04_right.overlay
 *
 * 右手側キーボード用の設定ファイル
 */

#include "at_ease_keys_04.overlay"

&kscan0 {
    // 右手側は7列なので、col-gpiosを7本に上書き
    col-gpios
        = <&gpio0  2 GPIO_ACTIVE_HIGH> // COL0 -> D0 (P0.02)
        , <&gpio0  3 GPIO_ACTIVE_HIGH> // COL1 -> D1 (P0.03)
        , <&gpio0 28 GPIO_ACTIVE_HIGH> // COL2 -> D2 (P0.28)
        , <&gpio1 15 GPIO_ACTIVE_HIGH> // COL3 -> D10 (P1.15)
        , <&gpio1 14 GPIO_ACTIVE_HIGH> // COL4 -> D9 (P1.14)
        , <&gpio1 13 GPIO_ACTIVE_HIGH> // COL5 -> D8 (P1.13)
        , <&gpio1 12 GPIO_ACTIVE_HIGH> // COL6 -> D7 (P1.12)
        ;

    // 右手側のマトリクス変換を定義
    matrix_transform: matrix_transform_0 {
        compatible = "zmk,matrix-transform";
        columns = <7>;
        rows = <4>;

        // キーマップ上で、左手側(8列)の隣から始まるようにオフセットを設定
        col-offset = <8>;
    };
};
